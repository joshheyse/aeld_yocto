## build/conf/bblayers.conf
```bitbake
# POKY_BBLAYERS_CONF_VERSION is increased each time build/conf/bblayers.conf
# changes incompatibly
POKY_BBLAYERS_CONF_VERSION = "2"

BBPATH = "${TOPDIR}"
BBFILES ?= ""

BBLAYERS ?= " \
  /home/josh/code/aeld_yocto/poky/meta \
  /home/josh/code/aeld_yocto/poky/meta-poky \
  /home/josh/code/aeld_yocto/poky/meta-yocto-bsp \
  /home/josh/code/aeld_yocto/meta-bbc \
  /home/josh/code/aeld_yocto/meta-openembedded/meta-oe \
  "
```

## meta-bbc/conf/layer.conf
```bitbake
# We have a conf and classes directory, add to BBPATH
BBPATH .= ":${LAYERDIR}"

# We have recipes-* directories, add to BBFILES
BBFILES += "${LAYERDIR}/recipes-*/*/*.bb \
            ${LAYERDIR}/recipes-*/*/*.bbappend"

BBFILE_COLLECTIONS += "meta-bbc"
BBFILE_PATTERN_meta-bbc = "^${LAYERDIR}/"
BBFILE_PRIORITY_meta-bbc = "6"

LAYERDEPENDS_meta-bbc = "core"
LAYERSERIES_COMPAT_meta-bbc = "scarthgap"
```
